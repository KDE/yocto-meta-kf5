## conf/layer.conf
```bitbake
# SPDX-FileCopyrightText: none
# SPDX-License-Identifier: CC0-1.0

# We have a conf and classes directory, add to BBPATH
BBPATH .= ":${LAYERDIR}"

# We have recipes-* directories, add to BBFILES
BBFILES += " \
    ${LAYERDIR}/recipes-*/*.bb \
    ${LAYERDIR}/recipes-*/*/*.bb \
    ${LAYERDIR}/recipes-*/*.bbappend \
    ${LAYERDIR}/recipes-*/*/*.bbappend \
"

BBFILE_COLLECTIONS += "kf5"
BBFILE_PATTERN_kf5 = "^${LAYERDIR}/"
BBFILE_PRIORITY_kf5 = "6"

LICENSE_PATH += "${LAYERDIR}/conf/licenses"

LAYERSERIES_COMPAT_kf5 = "warrior zeus dunfell gatesgarth"

# disable check per default until all recipes are updated
KF5_REUSE_LICENSECHECK_ENABLED = "0"
```
